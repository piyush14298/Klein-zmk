## config/west.yml
```yaml
manifest:
  remotes:
    - name: zmkfirmware
      url-base: https://github.com/zmkfirmware
    - name: infused-kim
      url-base: https://github.com/infused-kim
    - name: caksoylar
      url-base: https://github.com/caksoylar
  projects:
    - name: zmk-rgbled-widget
      remote: caksoylar
      revision: main
    - name: zmk
      remote: zmkfirmware
      revision: main
      import: app/west.yml
  self:
    path: config
```
